/* Generated by Keyboard Curator. Change the project, not this file. */

/ {
    underglow-layer {
        compatible = "zmk,underglow-layer";
        pixel-lookup = <41>, <53>, <5>, <17>, <29>, <40>, <52>, <64>, <4>, <16>, <28>, <39>, <51>, <63>, <3>, <15>, <27>, <38>, <50>, <62>, <2>, <14>, <26>, <37>, <49>, <61>, <1>, <13>, <25>, <36>, <48>, <60>, <0>, <12>, <24>, <70>, <71>, <72>, <76>, <77>, <78>;
    };
};

&led_strip {
    chain-length = <41>;
};
