/* Generated by Keyboard Curator. Change the project, not this file. */

/ {
    underglow-layer {
        compatible = "zmk,underglow-layer";
        pixel-lookup = <42>, <54>, <6>, <18>, <30>, <43>, <55>, <65>, <7>, <19>, <31>, <44>, <56>, <66>, <8>, <20>, <32>, <45>, <57>, <67>, <9>, <21>, <33>, <46>, <58>, <68>, <10>, <22>, <34>, <47>, <59>, <69>, <11>, <23>, <35>, <75>, <74>, <73>, <81>, <80>, <79>;
    };
};

&led_strip {
    chain-length = <41>;
};
